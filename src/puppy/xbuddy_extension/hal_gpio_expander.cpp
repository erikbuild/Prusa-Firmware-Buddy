/// @file
#include "hal_gpio_expander.hpp"

#include <stm32h5xx_hal.h>
#include <utility>

static I2C_HandleTypeDef hi2c;

extern "C" void HAL_I2C_MspInit(I2C_HandleTypeDef *hi2c) {
    if (hi2c->Instance == I2C2) {
        __HAL_RCC_I2C2_CONFIG(RCC_I2C2CLKSOURCE_PCLK1);
        __HAL_RCC_GPIOB_CLK_ENABLE();
        /**I2C2 GPIO Configuration
        PB10     ------> I2C2_SCL
        PB13     ------> I2C2_SDA
        */
        GPIO_InitTypeDef GPIO_InitStruct = {
            .Pin = GPIO_PIN_10 | GPIO_PIN_13,
            .Mode = GPIO_MODE_AF_OD,
            .Pull = GPIO_NOPULL,
            .Speed = GPIO_SPEED_FREQ_LOW,
            .Alternate = GPIO_AF4_I2C2,
        };
        HAL_GPIO_Init(GPIOB, &GPIO_InitStruct);

        /* Peripheral clock enable */
        __HAL_RCC_I2C2_CLK_ENABLE();
    }
}

static void i2c2_init() {
    hi2c.Instance = I2C2;
    hi2c.Init.OwnAddress1 = 0;
    hi2c.Init.Timing = 0x00707CBB; // Generated by stm32 cube IDE when using default settings 🤷
    hi2c.Init.AddressingMode = I2C_ADDRESSINGMODE_7BIT;
    hi2c.Init.DualAddressMode = I2C_DUALADDRESS_DISABLE;
    hi2c.Init.OwnAddress2 = 0;
    hi2c.Init.GeneralCallMode = I2C_GENERALCALL_DISABLE;
    hi2c.Init.NoStretchMode = I2C_NOSTRETCH_DISABLE;
    if (HAL_I2C_Init(&hi2c) != HAL_OK) {
        abort();
    }
}

namespace TCA6408A {

enum class Register : uint8_t {
    Input = 0,
    Output = 1,
    Polarity = 2,
    Config = 3,
};

static void write_register(Register reg, uint8_t value) {
    uint16_t device_address = 0x40;
    uint8_t data[2] = { std::to_underlying(reg), value };
    if (HAL_I2C_Master_Transmit(&hi2c, device_address, data, sizeof(data), HAL_MAX_DELAY) != HAL_OK) {
        abort();
    }
}

} // namespace TCA6408A

namespace hal::gpio_expander {

// safe state: all fans enabled, mmu power disabled
static uint8_t expander_pins = std::to_underlying(Pin::fan1) | std::to_underlying(Pin::fan2) | std::to_underlying(Pin::fan3);

} // namespace hal::gpio_expander

void hal::gpio_expander::init() {
    i2c2_init();

    // setup all signals before configuring pins as output
    TCA6408A::write_register(TCA6408A::Register::Output, expander_pins);

    // configure all pins as output
    TCA6408A::write_register(TCA6408A::Register::Config, 0x00);
}

void hal::gpio_expander::write(Pin pin, bool state) {
    if (state) {
        expander_pins |= std::to_underlying(pin);
    } else {
        expander_pins &= ~std::to_underlying(pin);
    }
    TCA6408A::write_register(TCA6408A::Register::Output, expander_pins);
}

bool hal::gpio_expander::read(Pin pin) {
    return expander_pins & std::to_underlying(pin);
}
